## build/conf/bblayers.conf
```bitbake
# POKY_BBLAYERS_CONF_VERSION is increased each time build/conf/bblayers.conf
# changes incompatibly

POKY_BBLAYERS_CONF_VERSION = "2"

BBPATH = "${TOPDIR}"
BBFILES ?= ""

BBLAYERS ?= " \
  /home/mamoru/yocto_rpi/poky/meta \
  /home/mamoru/yocto_rpi/poky/meta-poky \
  /home/mamoru/yocto_rpi/poky/meta-yocto-bsp \
  /home/mamoru/yocto_rpi/meta-openembedded/meta-oe \
  /home/mamoru/yocto_rpi/meta-openembedded/meta-python \
  /home/mamoru/yocto_rpi/meta-openembedded/meta-networking \
  /home/mamoru/yocto_rpi/meta-openembedded/meta-multimedia \
  /home/mamoru/yocto_rpi/meta-custom \
  /home/mamoru/yocto_rpi/meta-raspberrypi \
  " 
```
